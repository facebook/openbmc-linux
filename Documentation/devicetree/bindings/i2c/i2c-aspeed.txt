## Documentation/devicetree/bindings/i2c/i2c-aspeed.txt
```
Device tree configuration for the I2C busses on the AST24XX and AST25XX SoCs.

Required Properties:
- #address-cells	: should be 1
- #size-cells		: should be 0
- reg			: address offset and range of bus registers and buffer
- reg-names		: "bus-regs" and "buf" are recognized by Aspeed I2C
			  driver. "bus-regs" is default. "buf" is optional in
			  case of enabling I2C dedicated SRAM for buffer mode
			  transfer support
- compatible		: should be "aspeed,ast2400-i2c-bus"
			  or "aspeed,ast2500-i2c-bus"
- clocks		: root clock of bus, should reference the APB
			  clock in the second cell
- resets		: phandle to reset controller with the reset number in
			  the second cell
- interrupts		: interrupt number

Optional Properties:
- bus-frequency	: frequency of the bus clock in Hz defaults to 100 kHz when not
		  specified
- multi-master	: states that there is another master active on this bus.
- aspeed,dma-buf-size	: should be 4096 in case of AST2500.
			  Only AST2500 supports DMA mode under some limitations:
			  I2C is sharing the DMA H/W with UHCI host controller
			  and MCTP controller. Since those controllers operate
			  with DMA mode only, I2C has to use buffer mode or byte
			  mode instead if one of those controllers is enabled.
			  Also make sure that if SD/eMMC or Port80 snoop uses
			  DMA mode instead of PIO or FIFO respectively, I2C
			  can't use DMA mode. IF both DMA and buffer modes are
			  enabled, DMA mode will be selected.

Example:

i2c {
	compatible = "simple-bus";
	#address-cells = <1>;
	#size-cells = <1>;
	ranges = <0 0x1e78a000 0x1000>;

	i2c_gr: i2c-global-regs@0 {
		compatible = "aspeed,ast2500-i2c-gr", "syscon";
		reg = <0x0 0x40>;

		#address-cells = <1>;
		#size-cells = <1>;
		ranges = <0x0 0x0 0x40>;

		i2c_ic: interrupt-controller@0 {
			#interrupt-cells = <1>;
			compatible = "aspeed,ast2500-i2c-ic";
			reg = <0x0 0x4>;
			interrupts = <12>;
			interrupt-controller;
		};
	};

	i2c0: i2c-bus@40 {
		#address-cells = <1>;
		#size-cells = <0>;
		#interrupt-cells = <1>;
		reg = <0x40 0x40>;
		reg-names = "bus-regs";
		compatible = "aspeed,ast2500-i2c-bus";
		clocks = <&syscon ASPEED_CLK_APB>;
		resets = <&syscon ASPEED_RESET_I2C>;
		bus-frequency = <100000>;
		interrupts = <0>;
		interrupt-parent = <&i2c_ic>;
	};

	/* buffer mode transfer enabled */
	i2c1: i2c-bus@80 {
		#address-cells = <1>;
		#size-cells = <0>;
		#interrupt-cells = <1>;
		reg = <0x80 0x40>, <0x210 0x10>;
		reg-names = "bus-regs", "buf";
		compatible = "aspeed,ast2500-i2c-bus";
		clocks = <&syscon ASPEED_CLK_APB>;
		resets = <&syscon ASPEED_RESET_I2C>;
		bus-frequency = <100000>;
		interrupts = <1>;
		interrupt-parent = <&i2c_ic>;
	};

	/* DMA mode transfer enabled */
	i2c2: i2c-bus@c0 {
		#address-cells = <1>;
		#size-cells = <0>;
		#interrupt-cells = <1>;
		reg = <0xc0 0x40>;
		reg-names = "bus-regs";
		aspeed,dma-buf-size = <4095>;
		compatible = "aspeed,ast2500-i2c-bus";
		clocks = <&syscon ASPEED_CLK_APB>;
		resets = <&syscon ASPEED_RESET_I2C>;
		bus-frequency = <100000>;
		interrupts = <2>;
		interrupt-parent = <&i2c_ic>;
	};
};
```

## Documentation/devicetree/bindings/interrupt-controller/aspeed,aspeed-sdhci-ic.txt
```
Device tree configuration for the SDHCI Interrupt Controller on the AST24XX and
AST25XX SoCs.

Required Properties:
- #address-cells	: should be 1
- #size-cells 		: should be 1
- #interrupt-cells 	: should be 1
- compatible 		: should be "aspeed,aspeed-sdhci-ic"
- reg			: address start and range of controller
- interrupts		: interrupt number
- interrupt-controller	: denotes that the controller receives and fires
			  new interrupts for child busses

Example:

sdhci_ic: interrupt-controller@0 {
	#interrupt-cells = <1>;
	#size-cells = <1>;
	#interrupt-cells = <1>;
	compatible = "aspeed,aspeed-sdhci-irq";
	reg = <0x0 0x100>;
	interrupts = <26>;
	interrupt-controller;
	clocks = <&syscon ASPEED_CLK_GATE_SDCLK>;
};
```

## Documentation/devicetree/bindings/jtag/aspeed-jtag.txt
```
Aspeed JTAG driver for ast2400 and ast2500 SoC

Required properties:
- compatible:       Should be one of
      - "aspeed,ast2400-jtag"
      - "aspeed,ast2500-jtag"
- reg           contains the offset and length of the JTAG memory
            region
- clocks        root clock of bus, should reference the APB
            clock in the second cell
- resets        phandle to reset controller with the reset number in
            the second cell
- interrupts        should contain JTAG controller interrupt

Example:
jtag: jtag@1e6e4000 {
    compatible = "aspeed,ast2500-jtag";
    reg = <0x1e6e4000 0x1c>;
    clocks = <&syscon ASPEED_CLK_APB>;
    resets = <&syscon ASPEED_RESET_JTAG_MASTER>;
    interrupts = <43>;
};
```

## Documentation/devicetree/bindings/jtag/aspeed-jtag.yaml
```yaml
# SPDX-License-Identifier: (GPL-2.0-only OR BSD-2-Clause)
%YAML 1.2
---
$id: https://urldefense.proofpoint.com/v2/url?u=http-3A__devicetree.org_schemas_jtag_aspeed-2Djtag.yaml-23&d=DwIBAg&c=5VD0RTtNlTh3ycd41b3MUw&r=iYElT7HC77pRZ3byVvW8ng&m=vGWCsGcOo2XBzrFEoF2nIS4gWviJ18aq1W4UxkRbmXA&s=5LDPQjHKBcLkVCSOxFNx3oLtdKgpW5T1u56Km9Lch5s&e=
$schema: https://urldefense.proofpoint.com/v2/url?u=http-3A__devicetree.org_meta-2Dschemas_core.yaml-23&d=DwIBAg&c=5VD0RTtNlTh3ycd41b3MUw&r=iYElT7HC77pRZ3byVvW8ng&m=vGWCsGcOo2XBzrFEoF2nIS4gWviJ18aq1W4UxkRbmXA&s=r89VV7bcxrO-vDJsqHLKtJVbs-nZVmROiBZlM8YHtiQ&e=

title: Aspeed JTAG driver for ast2400 and ast2500 SoC

description:
  Driver adds support of Aspeed 2500/2400 series SOC JTAG master controller.
  Driver implements the following jtag ops
    freq_get
    freq_set
    status_get
    status_set
    xfer
    mode_set
    bitbang
    enable
    disable

  It has been tested on Mellanox system with BMC equipped with
  Aspeed 2520 SoC for programming CPLD devices.

  It has also been tested on Intel system using Aspeed 25xx SoC
  for JTAG communication.

maintainers:
  - Oleksandr Shamray <oleksandrs@mellanox.com>
  - Jiri Pirko <jiri@mellanox.com>
  - Ernesto Corona<ernesto.corona@intel.com>

properties:
  compatible:
    oneOf:
      - items:
          - enum:
              - aspeed,ast2400-jtag
              - aspeed,ast2500-jtag


  reg:
    items:
      - description: JTAG Master controller register range

  interrupts:
    maxItems: 1

  clocks:
    maxItems: 1

required:
  - compatible
  - reg
  - interrupts
  - clocks

examples:
  - |
    #include <dt-bindings/clock/aspeed-clock.h>
    #include <dt-bindings/interrupt-controller/irq.h>

      jtag: jtag@1e6e4000 {
          compatible = "aspeed,ast2500-jtag";
          reg = <0x1e6e4000 0x1c>;
          clocks = <&syscon ASPEED_CLK_APB>;
          resets = <&syscon ASPEED_RESET_JTAG_MASTER>;
          interrupts = <43>;
      };

...
```

## Documentation/devicetree/bindings/mfd/intel-peci-client.txt
```
* Intel PECI client bindings

PECI (Platform Environment Control Interface) is a one-wire bus interface that
provides a communication channel from PECI clients in Intel processors and
chipset components to external monitoring or control devices. PECI is designed
to support the following sideband functions:

- Processor and DRAM thermal management
- Platform Manageability
- Processor Interface Tuning and Diagnostics
- Failure Analysis

Required properties:
- compatible : Should be "intel,peci-client".
- reg        : Should contain address of a client CPU. According to the PECI
	       specification, client addresses start from 0x30.

Example:
	peci-bus@0 {
		compatible = "vendor,soc-peci";
		reg = <0x0 0x1000>;
		#address-cells = <1>;
		#size-cells = <0>;

		peci-client@30 {
			compatible = "intel,peci-client";
			reg = <0x30>;
		};

		peci-client@31 {
			compatible = "intel,peci-client";
			reg = <0x31>;
		};
	};
```

## Documentation/devicetree/bindings/mmc/aspeed,aspeed-sdhci.txt
```
Device Tree Bindings for the ASPEED SoC SDHCI Controller

This file documents differences between the core properties in mmc.txt
and the properties present in the ASPEED SDHCI

Required properties:
- compatible : should be "aspeed,ast2500-sdhci" or "aspeed,ast2400-sdhci"
- clocks : phandle + clock specifier pair of the external clock
- interrupts : interrupt number
- interrupt-parent : interrupt controller for bus, should reference a
                     aspeed,aspeed-sdhci-ic interrupt controller

Example:

sdhci {
	compatible = "simple-bus";
	#address-cells = <1>;
	#size-cells = <1>;
	ranges = <0 0x1e740000 0x1000>;

	sdhci_ic: interrupt-controller@0 {
		#interrupt-cells = <1>;
		compatible = "aspeed,aspeed-sdhci-irq";
		reg = <0x0 0x100>;
		interrupts = <26>;
		interrupt-controller;
		clocks = <&syscon ASPEED_CLK_GATE_SDCLK>;
		clock-names = "sdclk", "sd_extclk";
	};

	sdhci_slot0: sdhci_slot0@100 {
		compatible = "aspeed,sdhci-ast2500";
		reg = <0x100 0x100>;
		interrupts = <0>;
		interrupt-parent = <&sdhci_ic>;
		slot = <0>;
		sdhci,auto-cmd12;
		clocks = <&syscon ASPEED_CLK_SDIO>;
		pinctrl-names = "default";
		pinctrl-0 = <&pinctrl_sd1_default>;
	};
};
```

## Documentation/devicetree/bindings/mtd/npcm-fiu.txt
```
* Nuvoton FLASH Interface Unit (FIU) SPI Controller

NPCM FIU supports single, dual and quad communication interface.

The NPCM7XX supports three FIU modules,
FIU0 and FIUx supports two chip selects,
FIU3 support four chip select.

Required properties:
  - compatible : "nuvoton,npcm750-fiu" for the NPCM7XX BMC
  - #address-cells : should be 1.
  - #size-cells : should be 0.
  - reg : the first contains the register location and length,
          the second contains the memory mapping address and length
  - reg-names: Should contain the reg names "control" and "memory"
  - clocks : phandle of F reference clock.

Required properties in case the pins can be muxed:
  - pinctrl-names : a pinctrl state named "default" must be defined.
  - pinctrl-0 : phandle referencing pin configuration of the device.

Optional property:
  - spix-mode: enable spix-mode for an expansion bus to an ASIC or CPLD.

The SPI device must be a child of the FIU node and must have a
compatible property as specified in bindings/mtd/jedec,spi-nor.txt

Required property:
- reg: chip select number.

Optional property:
- spi-rx-bus-width: see ../spi/spi-bus.txt for the description.

Aliases:
- All the FIU controller nodes should be represented in the aliases node using
  the following format 'fiu{n}' where n is a unique number for the alias.
  In the NPCM7XX BMC:
  		fiu0 represent fiu 0 controller
  		fiu1 represent fiu 3 controller
  		fiu2 represent fiu x controller

Example:
fiu3: fiu@c00000000 {
	compatible = "nuvoton,npcm750-fiu";
	#address-cells = <1>;
	#size-cells = <0>;
	reg = <0xfb000000 0x1000>, <0x80000000 0x10000000>;
	reg-names = "control", "memory";
	clocks = <&clk NPCM7XX_CLK_AHB>;
	pinctrl-names = "default";
	pinctrl-0 = <&spi3_pins>;
	spi-nor@0 {
		compatible = "jedec,spi-nor";
		spi-rx-bus-width = <2>;
		#address-cells = <1>;
		#size-cells = <1>;
		reg = <0>;
		partition@0 {
			label = "flash_data";
			reg = <0x0 0x800000>;
		};
	};
};
```

## Documentation/devicetree/bindings/peci/peci-aspeed.txt
```
Device tree configuration for PECI buses on the AST24XX and AST25XX SoCs.

Required properties:
- compatible        : Should be one of:
			"aspeed,ast2400-peci"
			"aspeed,ast2500-peci"
- reg               : Should contain PECI controller registers location and
		      length.
- #address-cells    : Should be <1> required to define a client address.
- #size-cells       : Should be <0> required to define a client address.
- interrupts        : Should contain PECI controller interrupt.
- clocks            : Should contain clock source for PECI controller. Should
		      reference the external oscillator clock in the second
		      cell.
- resets            : Should contain phandle to reset controller with the reset
		      number in the second cell.
- clock-frequency   : Should contain the operation frequency of PECI controller
		      in units of Hz.
		      187500 ~ 24000000

Optional properties:
- msg-timing        : Message timing negotiation period. This value will
		      determine the period of message timing negotiation to be
		      issued by PECI controller. The unit of the programmed
		      value is four times of PECI clock period.
		      0 ~ 255 (default: 1)
- addr-timing       : Address timing negotiation period. This value will
		      determine the period of address timing negotiation to be
		      issued by PECI controller. The unit of the programmed
		      value is four times of PECI clock period.
		      0 ~ 255 (default: 1)
- rd-sampling-point : Read sampling point selection. The whole period of a bit
		      time will be divided into 16 time frames. This value will
		      determine the time frame in which the controller will
		      sample PECI signal for data read back. Usually in the
		      middle of a bit time is the best.
		      0 ~ 15 (default: 8)
- cmd-timeout-ms    : Command timeout in units of ms.
		      1 ~ 60000 (default: 1000)

Example:
	peci0: peci-bus@0 {
		compatible = "aspeed,ast2500-peci";
		reg = <0x0 0x60>;
		#address-cells = <1>;
		#size-cells = <0>;
		interrupts = <15>;
		clocks = <&syscon ASPEED_CLK_GATE_REFCLK>;
		resets = <&syscon ASPEED_RESET_PECI>;
		clock-frequency = <24000000>;
		msg-timing = <1>;
		addr-timing = <1>;
		rd-sampling-point = <8>;
		cmd-timeout-ms = <1000>;
	};
```

## Documentation/devicetree/bindings/pinctrl/nuvoton,npcm7xx-pinctrl.txt
```
Nuvoton NPCM7XX Pin Controllers

The NPCM7XX Pin Controller multi-function routed through
the multiplexing block, Each pin supports GPIO functionality (GPIOx)
and multiple functions that directly connect the pin to different
hardware blocks.

Required properties:
- compatible      : "nuvoton,npcm750-pinctrl" for Poleg NPCM750.

Contents of function subnode node
---------------------------------
Required subnode-properties:
- groups : An array of strings. Each string contains the name of a group.
- function: A string containing the name of the function to mux to the
  group.

  Valid values for group and function names can be found from looking at the
  group and function arrays in driver files:
  drivers/pinctrl/nuvoton/pinctrl-npcm7xx.c

For example, pinctrl might have subnodes like the following:
	r1err_pins: r1err_pins {
		groups = "r1err";
		function = "r1err";
	};
	r1md_pins: r1md_pins {
		groups = "r1md";
		function = "r1md";
	};
	r1_pins: r1_pins {
		groups = "r1";
		function = "r1";
	};

For a specific board, if it wants to use EMC (10/100 network),
it can add the following to its board-specific .dts file.
emc0: eth@f0825000 {
	pinctrl-names = "default";
	pinctrl-0 = <&r1_pins
				 &r1err_pins
				 &r1md_pins>;
	phy-mode = "rmii";

if EMC hardware is not used the EMC pin can used for GPIO56
	pinctrl-names = "default";
	pinctrl-0 = <&gpio56_pins>

Examples
========

pinctrl: pinctrl@0 {
	compatible = "nuvoton,npcm7xx-pinctrl";
	status = "okay";
	iox1_pins: iox1_pins {
		groups = "iox1";
		function = "iox1";
	};
	iox2_pins: iox2_pins {
		groups = "iox2";
		function = "iox2";
	};

	....

	clkreq_pins: clkreq_pins {
		groups = "clkreq";
		function = "clkreq";
	};
};
```
