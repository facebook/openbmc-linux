## Documentation/devicetree/bindings/soc/aspeed/xdma.txt
```
Aspeed AST25XX and AST26XX XDMA Engine

The XDMA Engine embedded in the AST2500 and AST2600 SOCs can perform automatic
DMA operations over PCI between the SOC (acting as a BMC) and a host processor.

Required properties:
 - compatible		: must be "aspeed,ast2500-xdma" or
			  "aspeed,ast2600-xdma"
 - reg			: contains the address and size of the memory region
			  associated with the XDMA engine registers
 - clocks		: clock specifier for the clock associated with the
			  XDMA engine
 - resets		: reset specifier for the syscon reset associated with
			  the XDMA engine
 - interrupts-extended	: two interrupt cells; the first specifies the global
			  interrupt for the XDMA engine and the second
			  specifies the PCI-E reset or PERST interrupt.
 - aspeed,scu		: a phandle to the syscon node for the system control
			  unit of the SOC
 - memory-region	: a phandle to the reserved memory region to be used by
			  the XDMA engine for DMA operations

Optional properties:
 - pcie-device		: should be either "bmc" or "vga", corresponding to
			  which device should be used by the XDMA engine for
			  DMA operations. If this property is not set, the XDMA
			  engine will use the BMC PCI-E device.

Example:

    xdma@1e6e7000 {
        compatible = "aspeed,ast2500-xdma";
        reg = <0x1e6e7000 0x100>;
        clocks = <&syscon ASPEED_CLK_GATE_BCLK>;
        resets = <&syscon ASPEED_RESET_XDMA>;
        interrupts-extended = <&vic 6>, <&scu_ic ASPEED_AST2500_SCU_IC_PCIE_RESET_LO_TO_HI>;
        aspeed,scu = <&syscon>;
        pcie-device = "bmc";
        memory-region = <&vga_memory>;
    };
```

## Documentation/devicetree/bindings/spi/spi-aspeed.txt
```
* Aspeed SPI Master Controller

The 2 SPI master controllers in the AST2500 each supports 2 chip selects.

Required properties:
  - compatible : Should be
	"aspeed,ast2500-spi-master" for the AST2500 SPI Controllers

  - reg : the first contains the control register location and length,
          the second contains the memory window mapping address and length
  - #address-cells : must be 1 corresponding to chip select child binding
  - #size-cells : must be 0 corresponding to chip select child binding
  - clocks: Must contain the clock source

Example:
spi1: flash-controller@1e630000 {
	reg = < 0x1e630000 0xc4
		0x30000000 0x08000000 >;
	#address-cells = <1>;
	#size-cells = <0>;
	compatible = "aspeed,ast2500-spi-master";
	clocks = <&syscon ASPEED_CLK_AHB>;
};
```

## arch/arm/mach-aspeed/Kconfig
```kconfig
if ARCH_ASPEED

choice
        prompt "ASPEED Processor Family"
        default CONFIG_IRMP

config IRMP
        bool "IRMP Serials"

config PCEXT
	bool "PC Extender Serials"

config REMOTEFX
	bool "RemoteFX Zero-Client Serials"

endchoice

if IRMP

choice
        prompt "IRMP Serials"
        default CONFIG_ARCH_AST2300

config ARCH_AST1100
	select CPU_ARM926T
        bool "AST1100"

config ARCH_AST2100
	select CPU_ARM926T
        bool "AST2100"

config ARCH_AST2200
	select CPU_ARM926T
        bool "AST2200"

config ARCH_AST2300
	select CPU_ARM926T
        bool "AST2300"

config ARCH_AST2400
	select CPU_ARM926T
	select USB_ARCH_HAS_EHCI
        bool "AST2400"

config ARCH_AST2500
#        select CPU_V6
	select USB_ARCH_HAS_EHCI
	select AST_UART_SDMA
	select EGFX_IRQ
        bool "AST2500"

endchoice

endif

if PCEXT

choice
        prompt "PC Extender Serials"
        default CONFIG_ARCH_AST1510

config ARCH_AST1500
	select CPU_ARM926T
        bool "AST1500"

config ARCH_AST1510
	select CPU_ARM926T
        bool "AST1510"

config ARCH_AST1520
	select CPU_V6
	select USB_ARCH_HAS_EHCI
	bool "AST1520"

endchoice

endif

if REMOTEFX

choice
        prompt "RemoteFX Zero-Client Serials"
        default CONFIG_ARCH_AST3100

config ARCH_AST3100
	select CPU_ARM926T
	select USB_ARCH_HAS_EHCI
        bool "AST3100"

config ARCH_AST3200
        select CPU_V6
	select USB_ARCH_HAS_EHCI
	select EGFX_IRQ
        bool "AST3200"

endchoice

endif

menu "FLASH Chip Select"

choice
        prompt "CS0 Config"
        default CONFIG_AST_CS0_SPI

config AST_CS0_NOR
        bool "NOR"

config AST_CS0_NAND
        bool "NAND"

config AST_CS0_SPI
        bool "SPI_NOR"

config AST_CS0_NONE
	bool "NONE"

endchoice

choice
        prompt "CS1 Config"
        default CONFIG_AST_CS1_SPI

config AST_CS1_NOR
        bool "NOR"

config AST_CS1_NAND
        bool "NAND"

config AST_CS1_SPI
        bool "SPI_NOR"

config AST_CS1_NONE
        bool "NONE"

endchoice

choice
        prompt "CS2 Config"
        default CONFIG_AST_CS2_SPI

config AST_CS2_NOR
        bool "NOR"

config AST_CS2_NAND
        bool "NAND"

config AST_CS2_SPI
        bool "SPI_NOR"

config AST_CS2_NONE
        bool "NONE"

endchoice

choice
        prompt "CS3 Config"
        default CONFIG_AST_CS3_SPI

config AST_CS3_NOR
        bool "NOR"

config AST_CS3_NAND
        bool "NAND"

config AST_CS3_SPI
        bool "SPI_NOR"

config AST_CS3_NONE
        bool "NONE"

endchoice

choice
        prompt "CS4 Config"
        default CONFIG_AST_CS4_SPI

config AST_CS4_NOR
        bool "NOR"

config AST_CS4_NAND
        bool "NAND"

config AST_CS4_SPI
        bool "SPI_NOR"

config AST_CS4_NONE
        bool "NONE"

endchoice

endmenu

config AST_SCU_LOCK
	bool "AST SCU Protection Key"

config AST1070_UART_DMA
	bool

config AST_UART_SDMA
	bool

config WEDGE
        bool "Facebook Wedge/6-Pack"

config WEDGE100
        bool "Facebook Wedge100"

config GALAXY100
        bool "Facebook GALAXY100 (Backpack) LC/FC"

config YOSEMITE
        bool "Facebook Yosemite"

config FBPLATFORM1
        bool "Facebook Platform1"

config AST_DUAL_FLASH
    bool "Build expecting a dual SPI configuration"

config FBTP
	select USB_ARCH_HAS_EHCI
	select AST_UART_SDMA
	select EGFX_IRQ
    bool "Facebook FBTP"

config FBTTN
	select USB_ARCH_HAS_EHCI
	select AST_UART_SDMA
	select EGFX_IRQ
    bool "Facebook FBTTN"

config LIGHTNING
        select USB_ARCH_HAS_EHCI
        select AST_UART_SDMA
        select EGFX_IRQ
    bool "Facebook Lightning"


config CMM
	select USB_ARCH_HAS_EHCI
	select AST_UART_SDMA
	select EGFX_IRQ
    bool "Facebook CMM"

config FBY2
 select USB_ARCH_HAS_EHCI
 select AST_UART_SDMA
 select EGFX_IRQ
    bool "Facebook FBY2"

config AST_CONSOLE_UART_BASE
    hex "Console UART base address"
    default 0x1e783000 if CMM
    default 0x1e78e000 if WEDGE || WEDGE100
    default 0x1e784000 if FBTP
    default 0x1e784000 if FBY2
    default 0x1e784000
	help
	  Please provide the physical address corresponding to the
	  location of main memory in your system.

endif
```

## drivers/apml/Kconfig
```kconfig
# SPDX-License-Identifier: GPL-2.0-only
#
# AMD APML BMC interface drivers
#

config APML_SBRMI
	tristate "Emulated SB-RMI interface driver over i2c or i3c bus"
	depends on I2C || I3C
	select REGMAP_I3C if I3C
	select REGMAP_I2C if I2C
	help
	  If you say yes here you get support for emulated RMI
	  interface on AMD SoCs with APML interface connected to a BMC device.

	  This driver can also be built as a module. If so, the module will
	  be called apml_sbrmi.

config APML_SBTSI
	tristate "Emulated SB-TSI interface driver over i2c or i3c bus"
	depends on I2C || I3C
	select REGMAP_I3C if I3C
	select REGMAP_I2C if I2C
	help
	  If you say yes here you get support for emulated TSI
	  interface on AMD SoCs with APML interface connected to a BMC device.

	  This driver can also be built as a module. If so, the module will
	  be called apml_sbtsi.
```

## drivers/char/aspeed/Kconfig
```kconfig
#
# MISC configuration for ASPEED SOCs
#

if ARCH_ASPEED
menuconfig AST_MISC
	tristate 'MISC drivers for ASPEED SOCs'
	help
	  We can select misc drivers for ASPEED SOC in this sub-function.

if AST_MISC
config AST_VIDEO
	tristate "ASPEED Video Engine driver"
	default n
	help
	  Driver for AST Video Engine 

config ADC_CAT9883
	tristate "CAT 9883 ADC driver"
	default n
	help
	  Driver for CAT 9883

config AST_SPI_BIOS
	tristate "ASPEED SPI BIOS flash register"
	default n
	help 
	  Driver for SPI BIOS flash register 

config AST_PECI
	tristate "ASPEED PECI Controller"
	default n
	help
	  Driver for PECI Controller

config AST_KCS
	tristate 'ASPEED KCS support'
	help
	  Support for the KCS channels on the ASPEED chips,
	  providing /dev/kcs0, 1 and 2 (note, some machines may not
	  provide all of these ports, depending on how the serial port
	  pins are configured.

config AST_GPIO
	tristate "ASPEED GPIO Controller"
	default n
	help
	  Driver for GPIO Controller included in ASPEED SOCs.

endif	# CONFIG_AST_MISC
endif	# CONFIG_AST
```

## drivers/hwmon/occ/Kconfig
```kconfig
#
# On-Chip Controller configuration
#

config SENSORS_OCC
	tristate "POWER On-Chip Controller"
	---help---
	This option enables support for monitoring a variety of system sensors
	provided by the On-Chip Controller (OCC) on a POWER processor.

	This driver can also be built as a module. If so, the module will be
	called occ-hwmon.

config SENSORS_OCC_P8_I2C
	bool "POWER8 OCC through I2C"
	depends on I2C && SENSORS_OCC
	---help---
	This option enables support for monitoring sensors provided by the OCC
	on a POWER8 processor. Communications with the OCC are established
	through I2C bus.

config SENSORS_OCC_P9_SBE
	bool "POWER9 OCC through SBE"
	depends on FSI_OCC && SENSORS_OCC
	---help---
	This option enables support for monitoring sensors provided by the OCC
	on a POWER9 processor. Communications with the OCC are established
	through SBE engine on an FSI bus.
```

## drivers/jtag/Kconfig
```kconfig
menuconfig JTAG
    tristate "JTAG support"
    ---help---
      This provides basic core functionality support for jtag class devices
      Hardware equipped with JTAG microcontroller which can be built
      on top of this drivers. Driver exposes the set of IOCTL to the
      user space for:
      SIR (Scan Instruction Register, IEEE 1149.1 Data Register scan);
      SDR (Scan Data Register, IEEE 1149.1 Instruction Register scan);
      RUNTEST (Forces IEEE 1149.1 bus to a run state for specified
      number of clocks).

      If you want this support, you should say Y here.

      To compile this driver as a module, choose M here: the module will
      be called jtag.

menuconfig JTAG_ASPEED
    tristate "Aspeed SoC JTAG controller support"
    depends on JTAG && HAS_IOMEM
    depends on ARCH_ASPEED || COMPILE_TEST
    ---help---
      This provides a support for Aspeed JTAG device, equipped on
      Aspeed SoC 24xx and 25xx families. Drivers allows programming
      of hardware devices, connected to SoC through the JTAG interface.

      If you want this support, you should say Y here.

      To compile this driver as a module, choose M here: the module will
      be called jtag-aspeed.

config JTAG_ASPEED_USE_INTERRUPTS
    bool "Enable interrupt mode"
    default y
    depends on JTAG_ASPEED
    ---help---
      If y, use Interrupt Service Routine(ISR) to monitor IR/DR transmission signal.
      Otherwise, use iteration instead.
```

## drivers/net/ethernet/aspeed/Kconfig
```kconfig
#
# Faraday device configuration
#

config NET_VENDOR_AST
	bool "AST devices"
	default y
	depends on PLAT_ASPEED
	---help---
	  If you have a network (Ethernet) card belonging to this class, say Y
	  and read the Ethernet-HOWTO, available from
	  <http://www.tldp.org/docs.html#howto>.

	  Note that the answer to this question doesn't directly affect the
	  kernel: saying N will just cause the configurator to skip all
	  the questions about Faraday cards. If you say Y, you will be asked for
	  your specific card in the following questions.

if NET_VENDOR_AST

config AST_MAC
        tristate "ASPEED Gigabit Ethernet support"
        depends on ARCH_ASPEED
        select PHYLIB
        help
          This driver supports the ASPEED Gigabit Ethernet controller.

endif # NET_VENDOR_AST
```

## drivers/net/ethernet/nuvoton/Kconfig
```kconfig
#
# Nuvoton network device configuration
#

config NET_VENDOR_NUVOTON
	bool "Nuvoton devices"
	default y
	depends on ARM && (ARCH_W90X900 || ARCH_NPCM7XX)
	---help---
	  If you have a network (Ethernet) card belonging to this class, say Y.

	  Note that the answer to this question doesn't directly affect the
	  kernel: saying N will just cause the configurator to skip all
	  the questions about Nuvoton cards. If you say Y, you will be asked
	  for your specific card in the following questions.

if NET_VENDOR_NUVOTON

config W90P910_ETH
	tristate "Nuvoton w90p910 Ethernet support"
	depends on ARM && ARCH_W90X900
	select PHYLIB
	select MII
	---help---
	  Say Y here if you want to use built-in Ethernet ports
	  on w90p910 processor.

config NPCM7XX_EMC_ETH
	bool "Nuvoton NPCM7XX Ethernet EMC"
	depends on ARM && ARCH_NPCM7XX
	select PHYLIB
	select MII
	help
	  Say Y here if you want to use built-in Ethernet MAC
	  on NPCM750 MCU.

config NPCM7XX_EMC_ETH_DEBUG
	bool "Nuvoton NPCM7XX Ethernet EMC debug"
	depends on NPCM7XX_EMC_ETH
	help
	  Say Y here if you want debug info via /proc/driver/npcm7xx_emc.x

endif # NET_VENDOR_NUVOTON
```

## drivers/peci/Kconfig
```kconfig
#
# Platform Environment Control Interface (PECI) subsystem configuration
#

config PECI
	bool "PECI support"
	select CRC8
	help
	  The Platform Environment Control Interface (PECI) is a one-wire bus
	  interface that provides a communication channel from Intel processors
	  and chipset components to external monitoring or control devices.

	  If you want PECI support, you should say Y here and also to the
	  specific driver for your bus adapter(s) below.

if PECI

config PECI_CHARDEV
	bool "PECI device interface"
	default y
	help
	  Say Y here to use peci-* device files, usually found in the /dev
	  directory on your system. They make it possible to have user-space
	  programs use the PECI bus.

#
# PECI hardware bus configuration
#

menu "PECI Hardware Bus support"

config PECI_ASPEED
	tristate "ASPEED PECI support"
	select REGMAP_MMIO
	depends on OF
	depends on ARCH_ASPEED || COMPILE_TEST
	help
	  Say Y here if you want support for the Platform Environment Control
	  Interface (PECI) bus adapter driver on the ASPEED SoCs.

	  This support is also available as a module.  If so, the module
	  will be called peci-aspeed.

endmenu

endif # PECI
```

## drivers/pinctrl/nuvoton/Kconfig
```kconfig
config PINCTRL_NPCM7XX
	bool "Pinctrl driver for Nuvoton NPCM7XX"
	depends on (ARCH_NPCM7XX || COMPILE_TEST) && OF
	select MFD_SYSCON
	select GPIOLIB
	select GPIOLIB_IRQCHIP
	select PINMUX
	select PINCONF
	select GENERIC_PINCONF
	help
	  Say Y here to enable pin controller and GPIO support 
	  for Nuvoton NPCM7xx SoCs.
```
