## drivers/soc/aspeed/Kconfig
```kconfig
# SPDX-License-Identifier: GPL-2.0-only
menu "Aspeed SoC drivers"

config SOC_ASPEED
	def_bool y
	depends on ARCH_ASPEED || COMPILE_TEST

config ASPEED_LPC_CTRL
	depends on SOC_ASPEED && REGMAP && MFD_SYSCON
	tristate "Aspeed ast2400/2500 HOST LPC to BMC bridge control"
	help
	  Control Aspeed ast2400/2500 HOST LPC to BMC mappings through
	  ioctl()s, the driver also provides a read/write interface to a BMC ram
	  region where the host LPC read/write region can be buffered.

config ASPEED_LPC_SNOOP
	tristate "Aspeed ast2500 HOST LPC snoop support"
	depends on SOC_ASPEED && REGMAP && MFD_SYSCON
	help
	  Provides a driver to control the LPC snoop interface which
	  allows the BMC to listen on and save the data written by
	  the host to an arbitrary LPC I/O port.

config ASPEED_P2A_CTRL
	depends on SOC_ASPEED && REGMAP && MFD_SYSCON
	tristate "Aspeed ast2400/2500 HOST P2A VGA MMIO to BMC bridge control"
	help
	  Control Aspeed ast2400/2500 HOST P2A VGA MMIO to BMC mappings through
	  ioctl()s, the driver also provides an interface for userspace mappings to
	  a pre-defined region.

config ASPEED_XDMA
	tristate "Aspeed XDMA Engine Driver"
	depends on SOC_ASPEED && REGMAP && MFD_SYSCON && HAS_DMA
	help
	  Enable support for the Aspeed XDMA Engine found on the Aspeed AST2XXX
	  SOCs. The XDMA engine can perform automatic PCI DMA operations
	  between the AST2XXX (acting as a BMC) and a host processor.

config ASPEED_ESPI
	tristate "Aspeed eSPI Engine Driver"
	depends on SOC_ASPEED && REGMAP && MFD_SYSCON
	help
	  Enable support for the Aspeed eSPI engine. The eSPI engine
	  plays as a slave device in BMC to communicate with the host
	  side master over the eSPI interface. The four eSPI channels,
	  namely peripheral, virtual wire, out-of-band, and flash are
	  supported.

config ASPEED_ESPI_MMBI
	tristate "Aspeed eSPI MMBI Driver"
	depends on ASPEED_ESPI
	help
	  Control Aspeed eSPI MMBI driver

config ASPEED_UDMA
	tristate "Aspeed UDMA Engine Driver"
	depends on ARCH_ASPEED && REGMAP && MFD_SYSCON && HAS_DMA
	help
	  Enable support for the Aspeed UDMA Engine found on the Aspeed AST2XXX
	  SOCs. The UDMA engine can perform UART DMA operations between the memory
	  buffer and the UART/VUART devices.

config ASPEED_UART_ROUTING
	tristate "Aspeed UART routing control"
	help
	  Control Aspeed UART routing via sysfs. This enables UART
	  and I/O components to be dynamically connected at runtime.

config ASPEED_LPC_PCC
	tristate "Aspeed Post Code Capture support"
	depends on SOC_ASPEED && REGMAP && MFD_SYSCON
	help
	  Provides a driver to control the LPC PCC interface,
	  allowing the BMC to snoop data bytes written by the
	  the host to an arbitrary LPC I/O port.

config ASPEED_OTP
	tristate "Aspeed OTP Driver"
	depends on MACH_ASPEED_G6

endmenu
```

## drivers/usb/astuhci/Kconfig
```kconfig
#
# USB Host Controller Drivers
#
comment "AST USB Drivers"
	depends on USB


config AST_USB_UHCI_HCD
	tristate "AST UHCI (USB 1.1) support"
	depends on USB
	---help---
	  The AST Universal Host Controller Interface (UHCI) is standard for 
	  USB 1.1 host controller hardware. It is an embedded HC based on AMBA bus.
	  You may want to read <file:Documentation/usb/uhci.txt>.

	  To compile this driver as a module, choose M here: the
	  module will be called uhci-hcd.

choice
	prompt "Config AST USB UHCI Number of Ports"
	default AST_USB_UHCI_MULTIPORT_4

config AST_USB_UHCI_MULTIPORT_1
	bool "AST UHCI support 1 ports"
	depends on AST_USB_UHCI_HCD

config AST_USB_UHCI_MULTIPORT_2
	bool "AST UHCI support 2 ports"
	depends on AST_USB_UHCI_HCD

config AST_USB_UHCI_MULTIPORT_4
	bool "AST UHCI support 4 ports"
	depends on AST_USB_UHCI_HCD

endchoice

config USB_EHCI_SPLIT_ISO
	bool "Full speed ISO transactions (EXPERIMENTAL)"
	depends on USB_EHCI_HCD
	default n
	---help---
	  This code is new and hasn't been used with many different
	  EHCI or USB 2.0 transaction translator implementations.
	  It should work for ISO-OUT transfers, like audio.

config USB_EHCI_ROOT_HUB_TT
	bool "Root Hub Transaction Translators (EXPERIMENTAL)"
	depends on USB_EHCI_HCD
	---help---
	  Some EHCI chips have vendor-specific extensions to integrate
	  transaction translators, so that no OHCI or UHCI companion
	  controller is needed.  It's safe to say "y" even if your
	  controller doesn't support this feature.

	  This supports the EHCI implementation from TransDimension Inc.
```

## drivers/usb/gucuhci/Kconfig
```kconfig
#
# USB Host Controller Drivers
#
comment "GUC USB Drivers"
	depends on USB


config GUC_USB_UHCI_HCD
	tristate "GUC UHCI (USB 1.1) support (EXPERIMENTAL)"
	depends on USB
	---help---
	  The GUC Universal Host Controller Interface (UHCI) is standard for 
	  USB 1.1 host controller hardware. It is an embedded HC based on AMBA bus.
	  You may want to read <file:Documentation/usb/uhci.txt>.

	  To compile this driver as a module, choose M here: the
	  module will be called uhci-hcd.

choice
	prompt "Config GUC USB UHCI Number of Ports"
	default GUC_USB_UHCI_MULTIPORT_4

config GUC_USB_UHCI_MULTIPORT_1
	bool "GUC UHCI support 1 ports"
	depends on GUC_USB_UHCI_HCD

config GUC_USB_UHCI_MULTIPORT_2
	bool "GUC UHCI support 2 ports"
	depends on GUC_USB_UHCI_HCD

config GUC_USB_UHCI_MULTIPORT_4
	bool "GUC UHCI support 4 ports"
	depends on GUC_USB_UHCI_HCD

endchoice

config USB_EHCI_SPLIT_ISO
	bool "Full speed ISO transactions (EXPERIMENTAL)"
	depends on USB_EHCI_HCD
	default n
	---help---
	  This code is new and hasn't been used with many different
	  EHCI or USB 2.0 transaction translator implementations.
	  It should work for ISO-OUT transfers, like audio.

config USB_EHCI_ROOT_HUB_TT
	bool "Root Hub Transaction Translators (EXPERIMENTAL)"
	depends on USB_EHCI_HCD
	---help---
	  Some EHCI chips have vendor-specific extensions to integrate
	  transaction translators, so that no OHCI or UHCI companion
	  controller is needed.  It's safe to say "y" even if your
	  controller doesn't support this feature.

	  This supports the EHCI implementation from TransDimension Inc.
```

## drivers/video/fbdev/aspeed/Kconfig
```kconfig
menuconfig FB_AST
	tristate "ASPEED Framebuffer Driver"
	depends on FB
	select FB_CFB_FILLRECT
	select FB_CFB_COPYAREA
	select FB_CFB_IMAGEBLIT
	default n

if FB_AST

config AST_DAC
	bool "CRT DAC output"

config AST_DVO
	bool "CRT DVO output"

endif
```
