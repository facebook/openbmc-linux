## meta-aspeed/recipes-kernel/linux/files/linux-aspeed-5.3/Documentation/devicetree/bindings/peci/peci-npcm.txt
```
Nuvoton NPCM Platform Environment Control Interface (PECI) bus

Required properties:
- compatible        : "nuvoton,npcm750-peci" for the NPCM7XX BMC.
- reg               : specifies PECI physical base address and size of the registers.
- #address-cells    : Should be <1> required to define a client address.
- #size-cells       : Should be <0> required to define a client address.
- interrupts        : Contain the PECI interrupt with flags for falling edge.
- clocks            : phandle of PECI reference clock.

Optional properties:
- cmd-timeout-ms    : Command timeout in units of ms.
                      1 ~ 60000 (default: 1000)
- pull-down         : Defines the PECI I/O internal pull down operation.
		      0 - pull down always enable (default)
		      1 - pull down only during transactions.
		      2 - pull down always disable.
- host-neg-bit-rate : Define host negotiation bit rate divider.
                      the host negotiation bit rate calculate with formula:
                      clock frequency[Hz] / [4 x {host-neg-bit-rate + 1}]
		      7 ~ 31 (default: 15)
- high-volt-range   : Adapts PECI I/O interface to voltage range, the property
                      is a boolean parameter define as follow:
		      false - PECI I/O interface voltage range of 0.8-1.06V. (default)
		      true - PECI I/O interface voltage range of 0.95-1.26V.

Example:
	peci: peci-bus@100000 {
		compatible = "nuvoton,npcm750-peci";
		reg = <0x100000 0x200>;
		#address-cells = <1>;
		#size-cells = <0>;
		interrupts = <GIC_SPI 6 IRQ_TYPE_LEVEL_HIGH>;
		clocks = <&clk NPCM7XX_CLK_APB3>;
		cmd-timeout-ms = <1000>;
		pull-down = <0>;
		host-neg-bit-rate = <15>;
	};
```

## meta-aspeed/recipes-kernel/linux/files/linux-aspeed-5.3/Documentation/devicetree/bindings/peci/peci.txt
```
Generic device tree configuration for PECI adapters
===================================================

Required properties:
- #address-cells : Should be <1>. Read more about client addresses below.
- #size-cells    : Should be <0>. Read more about client addresses below.

The cells properties above define that an address of CPU clients of a PECI bus
are described by a single value.

Example:
	peci0: peci-bus@0 {
		compatible = "vendor,soc-peci";
		reg = <0x0 0x1000>;
		#address-cells = <1>;
		#size-cells = <0>;
	};

Generic device tree configuration for PECI clients
==================================================

Required properties:
- compatible : Should contain name of PECI client.
- reg        : Should contain address of a client CPU. According to the PECI
	       specification, client addresses start from 0x30.

Example:
	peci-bus@0 {
		compatible = "vendor,soc-peci";
		reg = <0x0 0x1000>;
		#address-cells = <1>;
		#size-cells = <0>;

		peci-client@30 {
			compatible = "intel,peci-client";
			reg = <0x30>;
		};

		peci-client@31 {
			compatible = "intel,peci-client";
			reg = <0x31>;
		};
	};
```

## net/ncsi/Kconfig
```kconfig
#
# Configuration for NCSI support
#

config NET_NCSI
	bool "NCSI interface support"
	depends on INET
	---help---
	  This module provides NCSI (Network Controller Sideband Interface)
	  support. Enable this only if your system connects to a network
	  device via NCSI and the ethernet driver you're using supports
	  the protocol explicitly.
config NCSI_OEM_CMD_GET_MAC
	bool "Get NCSI OEM MAC Address"
	depends on NET_NCSI
	---help---
	  This allows to get MAC address from NCSI firmware and set them back to
		controller.
config NET_NCSI_MC_MAC_OFFSET
	int
	prompt "Offset of Management Controller's MAC Address"
	depends on NCSI_OEM_CMD_GET_MAC
	default 1
	---help---
	  This defines the offset between Network Controller's (base) MAC
	  address and Management Controller's MAC address.
config NCSI_SKIP_SEL_PKG
	bool "Skip sending NCSI Select/Deselect Package command"
	depends on NET_NCSI
	---help---
	  Workaround that some NICs may stop responding after receiving
	  NCSI Select/Deselect Package command.
config ENABLE_NCSI_TRACE
	bool "enable NC-SI trace"
	depends on NET_NCSI
	---help---
	  Enable debug kernel message for NC-SI to trace cmd/rsp/AENs
	  For debugging packet drop
```
